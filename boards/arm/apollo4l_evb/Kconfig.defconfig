## boards/arm/apollo4l_evb/Kconfig.defconfig
```kconfig
# SPDX-License-Identifier: Apache-2.0
#
# Copyright (c) 2023 Antmicro <www.antmicro.com>

config BOARD
	default "apollo4l_evb"
	depends on BOARD_APOLLO4L_EVB
```
